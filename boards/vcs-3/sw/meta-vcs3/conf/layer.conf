## boards/vcs-3/sw/meta-vcs3/conf/layer.conf
```bitbake
# SPDX-FileCopyrightText: Copyright (c) 2026 Advanced Micro Devices, Inc. All rights reserved.
# SPDX-FileCopyrightText: Copyright (c) 2026 Timor Knudsen (AMD)

# SPDX-License-Identifier: MIT

BBPATH .= ":${LAYERDIR}"
BBFILES += "${LAYERDIR}/recipes-*/*/*.bb ${LAYERDIR}/recipes-*/*/*.bbappend"

BBFILE_COLLECTIONS += "vcs3"
BBFILE_PATTERN_vcs3 = "^${LAYERDIR}/"
BBFILE_PRIORITY_vcs3 = "20"

LAYERDEPENDS_vcs3 = "core xilinx"
LAYERSERIES_COMPAT_vcs3 = "scarthgap"
```
